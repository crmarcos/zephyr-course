## app/drivers/our_driver/Kconfig
```kconfig
menu "OUR_DRIVER"

    menuconfig OUR_DRIVER
        bool "Our driver"
        default y
        depends on DT_HAS_OUR_DRIVER_ENABLED
        select GPIO
        help
            Enable the custom driver for the  GPIO peripheral

    if OUR_DRIVER
        config OUR_DRIVER_SHELL
            bool "Our driver shell"
            default y
    endif

endmenu
```

## boards/my_esp32_board/Kconfig.defconfig
```kconfig
# Copyright (c) 2026 Iomico
# SPDX-License-Identifier: Apache-2.0

if BOARD_MY_ESP32_BOARD

config HEAP_MEM_POOL_ADD_SIZE_BOARD
	int
	default 4096 if BOARD_MY_ESP32_BOARD_ESP32_PROCPU
	default 256 if BOARD_MY_ESP32_BOARD_ESP32_APPCPU

endif
```

## boards/my_esp32_board/Kconfig.my_esp32_board
```kconfig
# Copyright (c) 2026 Iomico
# SPDX-License-Identifier: Apache-2.0

config BOARD_MY_ESP32_BOARD
	select SOC_ESP32_D0WD_V3
	select SOC_ESP32_PROCPU if BOARD_MY_ESP32_BOARD_ESP32_PROCPU
	select SOC_ESP32_APPCPU if BOARD_MY_ESP32_BOARD_ESP32_APPCPU
```

## boards/my_esp32_board/board.yml
```yaml
board:
  name: my_esp32_board
  full_name: IOMICO MY ESP32 BOARD
  vendor: iomico
  socs:
    - name: esp32
```

## boards/my_esp32_board/my_esp32_board_procpu_defconfig
```kconfig
# Copyright (c) 2026 Iomico
# SPDX-License-Identifier: Apache-2.0

CONFIG_CONSOLE=y
CONFIG_SERIAL=y
CONFIG_UART_CONSOLE=y

CONFIG_ESP32_USE_UNSUPPORTED_REVISION=y

CONFIG_GPIO=y
```

## boards/my_esp32_board_from_scratch/Kconfig.my_esp32_board_from_scratch
```kconfig
config BOARD_MY_ESP32_BOARD_FROM_SCRATCH
	select SOC_ESP32_D0WD_V3
	select SOC_ESP32_PROCPU if BOARD_MY_ESP32_BOARD_FROM_SCRATCH_ESP32_PROCPU
	select SOC_ESP32_APPCPU if BOARD_MY_ESP32_BOARD_FROM_SCRATCH_ESP32_APPCPU

config HEAP_MEM_POOL_ADD_SIZE_BOARD
	int
	default 4096 if BOARD_MY_ESP32_BOARD_FROM_SCRATCH_ESP32_PROCPU
	default 256 if BOARD_MY_ESP32_BOARD_FROM_SCRATCH_ESP32_APPCPU


config ESP32_USE_UNSUPPORTED_REVISION
	bool
	default y

config CONSOLE
	bool
	default y

config SERIAL
	bool
	default y

config UART_CONSOLE
	bool
	default y

config GPIO
	bool
	default y
```

## boards/my_esp32_board_from_scratch/board.yml
```yaml
board:
  name: my_esp32_board_from_scratch
  full_name: IOMICO MY ESP32 BOARD FROM SCRATCH
  vendor: iomico
  socs:
    - name: esp32
```

## twister-out/native_sim_native/host/homework.unit.ring_buf/Kconfig/arch/Kconfig
```kconfig
# Load Zephyr Arch Kconfig descriptions.
osource "/home/marcos/workspace/deps/zephyr/arch/rx/Kconfig"
osource "/home/marcos/workspace/deps/zephyr/arch/x86/Kconfig"
osource "/home/marcos/workspace/deps/zephyr/arch/xtensa/Kconfig"
osource "/home/marcos/workspace/deps/zephyr/arch/sparc/Kconfig"
osource "/home/marcos/workspace/deps/zephyr/arch/riscv/Kconfig"
osource "/home/marcos/workspace/deps/zephyr/arch/posix/Kconfig"
osource "/home/marcos/workspace/deps/zephyr/arch/mips/Kconfig"
osource "/home/marcos/workspace/deps/zephyr/arch/arm64/Kconfig"
osource "/home/marcos/workspace/deps/zephyr/arch/arm/Kconfig"
osource "/home/marcos/workspace/deps/zephyr/arch/arc/Kconfig"
```

## twister-out/native_sim_native/host/homework.unit.ring_buf/Kconfig/boards/Kconfig
```kconfig
# Load Zephyr board Kconfig descriptions.
osource "/home/marcos/workspace/deps/zephyr/boards/native/native_sim/Kconfig"
```

## twister-out/native_sim_native/host/homework.unit.ring_buf/Kconfig/boards/Kconfig.defconfig
```kconfig
# Load Zephyr board defconfig descriptions.
osource "/home/marcos/workspace/deps/zephyr/boards/native/native_sim/Kconfig.defconfig"
```

## twister-out/native_sim_native/host/homework.unit.ring_buf/Kconfig/boards/Kconfig.sysbuild
```kconfig
# Load Sysbuild board Kconfig descriptions.
osource "/home/marcos/workspace/deps/zephyr/boards/native/native_sim/Kconfig.sysbuild"
```
