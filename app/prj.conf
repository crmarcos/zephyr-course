## CMakeLists.txt
```
cmake_minimum_required(VERSION 3.20.0)

list(APPEND BOARD_ROOT ${CMAKE_CURRENT_SOURCE_DIR}/../) 
find_package(Zephyr REQUIRED)
project(my_zephyr_app)

target_sources(app PRIVATE src/main.cpp)

add_subdirectory(drivers/our_driver)
```

## Kconfig
```
menuconfig LED_SUBSYSTEM
    bool "LED Subsystem"
    default y

if LED_SUBSYSTEM

    config APP_HEARTBEAT_PERIOD_MS
        int "Sleep duration"
        default 500
        range 100 2000


endif # LED_SUBSYSTEM


source "Kconfig.zephyr"
rsource "drivers/our_driver/Kconfig"
```

## prj.conf
```kconfig
CONFIG_GPIO=y
CONFIG_LOG=y

CONFIG_SHELL=y
CONFIG_OUR_DRIVER_SHELL=y
```

## app.overlay
```dts
/ {
    aliases {
        app-led = &led0;
    };

    our_driver0: our_driver {
        compatible = "our,driver";
        status = "okay";
    };
};
```

## dts/bindings/our,driver.yaml
```yaml
description: Our Driver
compatible: "our,driver"
include: base.yaml
```

## src/main.cpp
```c
#include <zephyr/kernel.h>
#include <zephyr/logging/log.h>

#include<zephyr/drivers/sensor.h>

#include "../drivers/our_driver/our_driver.h"


// Get our_driver
const struct device* driver = DEVICE_DT_GET(DT_NODELABEL(our_driver0));

LOG_MODULE_REGISTER(main, LOG_LEVEL_INF);


int main(void)
{

    // Check for device
    if (!device_is_ready(driver)) {return -ENODEV;}

    // Call device functions
    struct sensor_value val;
    int ret;

    ret = sensor_channel_get(driver, SENSOR_CHAN_AMBIENT_TEMP, &val);
    ret = sensor_sample_fetch(driver);

    // Enter infinite loop
    while (1) {
        k_msleep(CONFIG_APP_HEARTBEAT_PERIOD_MS);
    }
    return 0;
}
```
